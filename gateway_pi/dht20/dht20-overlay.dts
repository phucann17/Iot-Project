/dts-v1/;
/plugin/;

/ {
    compatible = "brcm,bcm2835";

    fragment@0 {
        target = <&i2c1>;

        __overlay__ {
            #address-cells = <1>;
            #size-cells = <0>;

            dht20@38 {
                compatible = "aosong,dht20";
                reg = <0x38>;
                status = "okay";
            };
        };
    };
};